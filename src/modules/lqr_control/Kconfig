## src/modules/lqr_control/Kconfig
```kconfig
menuconfig MODULES_LQR_CONTROL
	bool "lqr_control"
	default n
	---help---
		System Theory Lab LQR Controller; replaces default attitude and rate controller
```

## src/modules/mc_lqr_control/Kconfig
```kconfig
menuconfig MODULES_MC_LQR_CONTROL
	bool "mc_lqr_control"
	default n
	---help---
		System Theory Lab LQR Controller; replaces default attitude and rate controller
```
